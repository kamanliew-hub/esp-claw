## application/edge_agent/boards/lilygo/lilygo_t_display_p4/Kconfig.projbuild
```kconfig
menu "lilygo t-display-p4 configuration"

    choice
        prompt "Select the camera type"
        default CAMERA_TYPE_OV2710
            config CAMERA_TYPE_SC2336
                bool "SC2336"
            config CAMERA_TYPE_OV2710
                bool "OV2710"
            config CAMERA_TYPE_OV5645
                bool "OV5645"
    endchoice

    choice
        prompt "Select the screen type"
        default SCREEN_TYPE_HI8561
            config SCREEN_TYPE_HI8561
                bool "HI8561"
            config SCREEN_TYPE_RM69A10
                bool "RM69A10"
    endchoice

    choice
        prompt "Select the color format of the screen"
        default SCREEN_PIXEL_FORMAT_RGB565
            config SCREEN_PIXEL_FORMAT_RGB565
                bool "RGB565"
            config SCREEN_PIXEL_FORMAT_RGB888
                bool "RGB888"
    endchoice

    choice
        prompt "Select the color format of the camera"
        default CAMERA_PIXEL_FORMAT_RGB565
            config CAMERA_PIXEL_FORMAT_RGB565
                bool "RGB565"
            config CAMERA_PIXEL_FORMAT_RGB888
                bool "RGB888"
    endchoice

    choice BOARD_TYPE
        prompt "Board type"
        default BOARD_TYPE_T_DISPLAY_P4
        config BOARD_TYPE_T_DISPLAY_P4
            bool "t-display-p4"
        config BOARD_TYPE_T_DISPLAY_P4_KEYBOARD
            bool "t-display-p4-keyboard"
    endchoice

    choice BOARD_VERSION_T_DISPLAY_P4
        prompt "Board version T-Display-P4"
        default BOARD_VERSION_T_DISPLAY_P4_V2_0
        config BOARD_VERSION_T_DISPLAY_P4_V1_0
            bool "t-display-p4_v1.0"
        config BOARD_VERSION_T_DISPLAY_P4_V2_0
            bool "t-display-p4_v2.0"
    endchoice

endmenu
```

## application/edge_agent/boards/lilygo/lilygo_t_display_p4/sdkconfig.defaults.board
```kconfig
CONFIG_LILYGO_DEVICE_DRIVER_T_DISPLAY_P4=y
CONFIG_LILYGO_DEVICE_DRIVER_LOG_LEVEL_INFO=y

CONFIG_CPP_BUS_DRIVER_LOG_LEVEL_INFO=y

CONFIG_ESP_BOARD_DEV_DISPLAY_LCD_SUPPORT=y
CONFIG_APP_CLAW_ENABLE_EMOTE=y

CONFIG_ESPTOOLPY_FLASHSIZE_16MB=y
CONFIG_ESPTOOLPY_FLASHFREQ_120M=y
CONFIG_SPIRAM=y
CONFIG_SPIRAM_MODE_HEX=y
CONFIG_SPIRAM_SPEED_200M=y
CONFIG_CACHE_L2_CACHE_256KB=y
CONFIG_CACHE_L2_CACHE_LINE_128B=y

CONFIG_CAMERA_SC2336=y
CONFIG_CAMERA_SC2336_MIPI_RAW8_1280x720_30FPS=n
CONFIG_CAMERA_SC2336_MIPI_RAW10_1280x720_30FPS=y

CONFIG_CAMERA_OV2710=y
CONFIG_CAMERA_OV2710_MIPI_RAW10_1280X720_25FPS=y
CONFIG_CAMERA_OV2710_MIPI_RAW10_1920X1080_25FPS=n

CONFIG_CAMERA_OV5645=y
CONFIG_CAMERA_OV5645_MIPI_RGB565_1280X960_30FPS=y
CONFIG_CAMERA_OV5645_MIPI_YUV422_1280X960_30FPS=n

CONFIG_ETHERNET_PHY_IP101=y
CONFIG_ETHERNET_PHY_RST_GPIO=-1

CONFIG_SLAVE_IDF_TARGET_ESP32C6=y
CONFIG_ESP_HOSTED_SDIO_GPIO_RESET_SLAVE=100
```

## components/common/emote/Kconfig
```kconfig
menu "Emote"

    config EMOTE_RGB888_SUPPORT
        bool "Enable RGB888 LCD flush conversion"
        depends on ESP_BOARD_DEV_DISPLAY_LCD_SUPPORT
        default n
        help
            Enable RGB565-to-RGB888 conversion in the emote flush path for 24-bit LCD panels.
            The emote renderer keeps RGB565 as its internal format and expands pixels before
            passing frame chunks to esp_lcd_panel_draw_bitmap().

endmenu
```
